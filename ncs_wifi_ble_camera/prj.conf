## CMakeLists.txt
```
#
# Copyright (c) 2022 Nordic Semiconductor ASA
#
# SPDX-License-Identifier: LicenseRef-Nordic-5-Clause
#

cmake_minimum_required(VERSION 3.20.0)

find_package(Zephyr REQUIRED HINTS $ENV{ZEPHYR_BASE})
project(WiFi_BLE_Camera)

FILE(GLOB app_sources src/*.c)
target_sources(app PRIVATE ${app_sources})
target_include_directories(app PRIVATE include)
```

## Kconfig
```
source "Kconfig.zephyr"

menu "Nordic WiFi BLE Demo"

config SOFTAP_SAMPLE_DHCPV4_SERVER
	bool "DHCPv4 server"
	select NET_DHCPV4_SERVER
	default y
	help
	  Enable this to configure DHCPV4 server settings.

config SOFTAP_SAMPLE_DHCPV4_POOL_START
	string "Start address of DHCPv4 pool"
	default "192.168.1.2"
	help
	  Set the start IP address of DHCPv4 pool.

config SOFTAP_SAMPLE_REG_DOMAIN
	string "The ISO/IEC alpha2 country code"
	default "00"
	help
	  Set the ISO/IEC alpha2 country code for the country in
	  which the device is currently operating.
	  For world regulatory, use "00".

choice SOFTAP_SAMPLE_FREQUENCY_BAND
	prompt "Wi-Fi frequency band for SoftAp"
	default SOFTAP_SAMPLE_2_4GHz

config SOFTAP_SAMPLE_2_4GHz
	bool "2.4 GHz band"
	help
	  Enable this option if the SoftAP should operate in the 2.4 GHz band.

config SOFTAP_SAMPLE_5GHz
	bool "5 GHz band"
	help
	  Enable this option if the SoftAP should operate in the 5 GHz band.
	  Ensure that you have the appropriate regulatory settings configured.
endchoice

config SOFTAP_SAMPLE_CHANNEL
	int "SoftAP channel"
	range 1 255
	default 1 if SOFTAP_SAMPLE_2_4GHz
	default 36 if SOFTAP_SAMPLE_5GHz
	help
	  Set the Wi-Fi channel on which the SoftAP will operate.

config SOFTAP_SAMPLE_SSID
	string "SoftAP SSID"
	default "myssid"
	help
	  Set the SSID (Service Set Identifier) for the SoftAP.
	  This is the name that will be broadcasted for client(s) to connect.

choice  SOFTAP_SAMPLE_KEY_MGMT_SELECT
	prompt "Security option for SoftAP"
	default SOFTAP_SAMPLE_KEY_MGMT_WPA2

config SOFTAP_SAMPLE_KEY_MGMT_NONE
	bool "Open security"
	help
	  Enable for open security

config SOFTAP_SAMPLE_KEY_MGMT_WPA2
	bool "WPA2 security"
	help
	  Enable for WPA2 security

config SOFTAP_SAMPLE_KEY_MGMT_WPA2_256
	bool "WPA2 SHA 256 security"
	help
	  Enable for WPA2-PSK-256 security.

config SOFTAP_SAMPLE_KEY_MGMT_WPA3
	bool "WPA3 security"
	help
	  Enable for WPA3 security.
endchoice

config SOFTAP_SAMPLE_PASSWORD
	string "Passphrase (WPA2) or password (WPA3)"
	default "mypassword"
	help
	  Set the password for SoftAP.

config SOFTAP_SAMPLE_MAX_STATIONS
	int "Maximum number of stations"
	# Experimental support for one, but in future support for up to 8 (nRF70 limitation)
	range 1 1
	default 1
	help
	  Set the maximum number of stations allowed to connect to the SoftAP.

config SAMPLE_SCOKET_TCP
	bool "Use TCP socket for data transmission"
	default y
	help
	  Set socket for data transmission, y to TCP, n to UDP.
endmenu
```

## prj.conf
```kconfig
#
# Copyright (c) 2022 Nordic Semiconductor ASA
#
# SPDX-License-Identifier: LicenseRef-Nordic-5-Clause
#

# Wi-Fi
CONFIG_WIFI=y
CONFIG_WIFI_NRF700X=y

# WPA supplicant
CONFIG_WPA_SUPP=y

# Soft AP Mode
CONFIG_NRF700X_AP_MODE=y
CONFIG_WPA_SUPP_AP=y
CONFIG_WPA_SUPP_LOG_LEVEL_INF=y
CONFIG_WIFI_READY_LIB=y
CONFIG_FILE_SYSTEM=y

CONFIG_SOFTAP_SAMPLE_5GHz=y
CONFIG_SOFTAP_SAMPLE_CHANNEL=36
CONFIG_SOFTAP_SAMPLE_REG_DOMAIN="NO"
CONFIG_SAMPLE_SCOKET_TCP=n
CONFIG_SOFTAP_SAMPLE_SSID="WiFi_Cam_Demo_AP"
CONFIG_SOFTAP_SAMPLE_PASSWORD="nRF7002DK"
# Station Mode
# Configure the Wi-Fi credentials
CONFIG_WIFI_CREDENTIALS=y
CONFIG_WIFI_CREDENTIALS_STATIC=n
CONFIG_WIFI_CREDENTIALS_BACKEND_SETTINGS=y
CONFIG_FLASH=y
CONFIG_FLASH_PAGE_LAYOUT=y
CONFIG_FLASH_MAP=y
CONFIG_NVS=y
CONFIG_SETTINGS=y
CONFIG_SETTINGS_NVS=y
# Enable support for shell commands
CONFIG_SHELL=y
CONFIG_SHELL_STACK_SIZE=8192
CONFIG_WIFI_CREDENTIALS_SHELL=y

# Networking Management API
# Enable the Network Management relevant configurations
CONFIG_NET_MGMT=y
CONFIG_NET_MGMT_EVENT=y
CONFIG_NET_MGMT_EVENT_INFO=y
CONFIG_NET_MGMT_EVENT_STACK_SIZE=4096
CONFIG_NET_CONNECTION_MANAGER=y
#CONFIG_L2_WIFI_CONNECTIVITY=y

# Logging
CONFIG_LOG=y
CONFIG_LOG_DEFAULT_LEVEL=3

# DK library
CONFIG_DK_LIBRARY=y

# Networking
CONFIG_NETWORKING=y
CONFIG_NET_NATIVE=y
CONFIG_NET_SOCKETS=y
CONFIG_NET_LOG=y
CONFIG_NET_IPV4=y
CONFIG_NET_TCP=y
CONFIG_NET_UDP=y
CONFIG_NET_DHCPV4=y

CONFIG_NET_PKT_RX_COUNT=8
CONFIG_NET_PKT_TX_COUNT=8

# Below section is the primary contributor to SRAM and is currently
# tuned for performance, but this will be revisited in the future.
CONFIG_NET_BUF_RX_COUNT=16
CONFIG_NET_BUF_TX_COUNT=16
CONFIG_NET_BUF_DATA_SIZE=1500
CONFIG_HEAP_MEM_POOL_SIZE=153600
CONFIG_NET_TC_TX_COUNT=1

CONFIG_NET_IF_UNICAST_IPV4_ADDR_COUNT=1
CONFIG_NET_MAX_CONTEXTS=5
CONFIG_NET_CONTEXT_SYNC_RECV=y

CONFIG_INIT_STACKS=y

CONFIG_NET_L2_ETHERNET=y

CONFIG_NET_CONFIG_SETTINGS=y
CONFIG_NET_CONFIG_INIT_TIMEOUT=0

CONFIG_NET_SOCKETS_POLL_MAX=10

CONFIG_NET_CONFIG_MY_IPV4_ADDR="192.168.1.1"
CONFIG_NET_CONFIG_MY_IPV4_NETMASK="255.255.255.0"
CONFIG_NET_CONFIG_MY_IPV4_GW="192.168.1.1"

# printing of scan results puts pressure on queues in new locking
# design in net_mgmt. So, use a higher timeout for a crowded
# environment.
CONFIG_NET_MGMT_EVENT_QUEUE_TIMEOUT=5000

# Memories
CONFIG_MAIN_STACK_SIZE=4096
CONFIG_SYSTEM_WORKQUEUE_STACK_SIZE=2048
CONFIG_NET_TX_STACK_SIZE=4096
CONFIG_NET_RX_STACK_SIZE=4096

# Bluetooth
CONFIG_BT=y
CONFIG_BT_PERIPHERAL=y
CONFIG_BT_GATT_CLIENT=y
CONFIG_BT_DEVICE_NAME="WiFi_BLE_Cam_Demo"
CONFIG_BT_DEVICE_APPEARANCE=833
CONFIG_BT_MAX_CONN=1
CONFIG_BT_MAX_PAIRED=1
CONFIG_BT_BUF_ACL_RX_SIZE=502
CONFIG_BT_ATT_PREPARE_COUNT=2
CONFIG_BT_L2CAP_TX_BUF_COUNT=10
CONFIG_BT_L2CAP_TX_MTU=498
CONFIG_BT_CONN_TX_MAX=10
CONFIG_BT_BUF_ACL_TX_COUNT=10
CONFIG_BT_BUF_ACL_TX_SIZE=502
CONFIG_BT_USER_DATA_LEN_UPDATE=y
CONFIG_BT_USER_PHY_UPDATE=y
CONFIG_BT_HCI_CORE_LOG_LEVEL_INF=y
CONFIG_BT_RX_STACK_SIZE=8192

# Kernel options
CONFIG_ENTROPY_GENERATOR=y

# Arducam Mega SPI Camera
CONFIG_SPI=y
CONFIG_VIDEO=y
CONFIG_VIDEO_INIT_PRIORITY=72
CONFIG_VIDEO_BUFFER_POOL_SZ_MAX=8192
CONFIG_VIDEO_BUFFER_POOL_NUM_MAX=3

CONFIG_DEBUG=y
```

## overlay-wifi-crendtials-static.conf
```kconfig
# Enable static Wi-Fi network configuration
CONFIG_WIFI_CREDENTIALS_STATIC=y
CONFIG_WIFI_CREDENTIALS_STATIC_SSID="Get-CS"
CONFIG_WIFI_CREDENTIALS_STATIC_PASSWORD="Charlie40396615"


# Disable support for shell commands
CONFIG_SHELL=n
# CONFIG_WIFI_CREDENTIALS_SHELL=n
```

## overlay_tcp_socket.conf
```kconfig
CONFIG_SAMPLE_SCOKET_TCP=y
```

## src/main.c
```c
/*
 * Copyright (c) 2024 Nordic Semiconductor ASA
 *
 * SPDX-License-Identifier: LicenseRef-Nordic-5-Clause
 */

/** @file
 * @brief WiFi Camera Demo
 */

#include <zephyr/logging/log.h>
LOG_MODULE_REGISTER(WiFiCam, CONFIG_LOG_DEFAULT_LEVEL);

#if defined(CLOCK_FEATURE_HFCLK_DIVIDE_PRESENT) || NRF_CLOCK_HAS_HFCLK192M
#include <nrfx_clock.h>
#endif

#include <stdio.h>
#include <zephyr/device.h>
#include <zephyr/kernel.h>
#include <zephyr/drivers/video.h>
#include <zephyr/drivers/video/arducam_mega.h>

#include "app_bluetooth.h"
#include "socket_util.h"

/**********External Resources START**************/
extern struct sockaddr_in pc_addr;
/**********External Resources END**************/

#define RESET_CAMERA 0XFF
#define SET_PICTURE_RESOLUTION 0X01
#define SET_VIDEO_RESOLUTION 0X02
#define SET_BRIGHTNESS 0X03
#define SET_CONTRAST 0X04
#define SET_SATURATION 0X05
#define SET_EV 0X06
#define SET_WHITEBALANCE 0X07
#define SET_SPECIAL_EFFECTS 0X08
#define SET_FOCUS_ENABLE 0X09
#define SET_EXPOSURE_GAIN_ENABLE 0X0A
#define SET_WHITE_BALANCE_ENABLE 0X0C
#define SET_MANUAL_GAIN 0X0D
#define SET_MANUAL_EXPOSURE 0X0E
#define GET_CAMERA_INFO 0X0F
#define TAKE_PICTURE 0X10
#define SET_SHARPNESS 0X11
#define DEBUG_WRITE_REGISTER 0X12
#define STOP_STREAM 0X21
#define GET_FRM_VER_INFO 0X30
#define GET_SDK_VER_INFO 0X40
#define SET_IMAGE_QUALITY 0X50
#define SET_LOWPOWER_MODE 0X60

/*
** Arducam mega communication protocols
** https://www.arducam.com/docs/arducam-mega/arducam-mega-getting-started/packs/HostCommunicationProtocol.html
*/

const struct device *video;
struct video_buffer *vbuf;
static struct arducam_mega_info mega_info;

enum client_type {
	client_type_NONE,
	client_type_BLE,
	client_type_SOCKET
};

enum app_command_type {APPCMD_CAM_COMMAND, APPCMD_TAKE_PICTURE, APPCMD_START_STOP_STREAM, APPCMD_SOCKET_RX};

struct app_command_t {
	enum app_command_type type;
	enum client_type mode;
	uint8_t cam_cmd;
	uint8_t data[6];
};

K_MSGQ_DEFINE(msgq_app_commands, sizeof(struct app_command_t), 8, 4);

struct client_state {
	uint8_t req_stream : 1;
	uint8_t req_stream_stop : 1;
	uint8_t stream_active : 1;
};
struct client_state client_state_ble = {0};
struct client_state client_state_socket = {0};

static void on_timer_count_bytes_func(struct k_timer *timer);
K_TIMER_DEFINE(m_timer_count_bytes, on_timer_count_bytes_func, NULL);
static int counted_bytes_sent = 0;

/* actucal command not count start(0x55) and stop(0xAA) codes*/
uint8_t socket_head_and_tail[] = {0xff, 0xaa, 0x00, 0xff, 0xbb};

const uint32_t pixel_format_table[] = {
	VIDEO_PIX_FMT_JPEG,
	VIDEO_PIX_FMT_RGB565,
	VIDEO_PIX_FMT_YUYV,
};

const uint16_t resolution_table[][2] = {
	{160, 120},
	{320, 240},
	{640, 480},
	{800, 600},
	{1280, 720},
	{1280, 960},
	{1600, 1200},
	{1920, 1080},
	{2048, 1536},
	{2592, 1944},
	{96, 96},
	{128, 128},
	{320, 320},
};

const uint8_t resolution_num = sizeof(resolution_table) / 4;

static uint8_t current_resolution;
static uint8_t take_picture_fmt = 0x1a;

void cam_to_pc_command_send(uint8_t type, uint8_t *buffer, uint32_t length)
{
	socket_head_and_tail[2] = type;
	cam_send(&socket_head_and_tail, 3);
	if(length!=0){
		cam_send((uint8_t *)&length, 4);
		cam_send(buffer, length);
	}
	cam_send(&socket_head_and_tail[3], 2);
}

int set_mega_resolution(uint8_t sfmt, enum client_type source_client)
{
	uint8_t resolution = sfmt & 0x0f;
	uint8_t pixelformat = (sfmt & 0x70) >> 4;

	// If the source is the Bluetooth client, and one of the max resolutions are selected (3MP or 5MP), ensure the right max resolution is selected based on the connected camera type
	if (source_client == client_type_BLE && (resolution == 8 || resolution == 9)) {
		resolution = ((mega_info.camera_id == ARDUCAM_SENSOR_3MP_1 || mega_info.camera_id == ARDUCAM_SENSOR_3MP_2)) ? 8 : 9;
	}

	if (resolution > resolution_num || pixelformat > 3)
	{
		return -1;
	}
	struct video_format fmt = {.width = resolution_table[resolution][0],
							   .height = resolution_table[resolution][1],
							   .pixelformat = pixel_format_table[pixelformat - 1]};
	// If the resolution has changed, and the client that initiated the change was socket, notify the BLE client
	if (resolution != current_resolution) {
		if (source_client == client_type_SOCKET) {
			app_bt_send_client_status(((mega_info.camera_id == ARDUCAM_SENSOR_3MP_1 || mega_info.camera_id == ARDUCAM_SENSOR_3MP_2)) ? 1 : 2, resolution);
		} else if (source_client == client_type_BLE) {
			cam_to_pc_command_send(0x07, &resolution, sizeof(resolution));
		}
	}

	current_resolution = resolution;

	return video_set_format(video, VIDEO_EP_OUT, &fmt);
}

void cam_send_picture_data_socket(uint8_t *data, int length)
{
	counted_bytes_sent += length;
	while (length >= 1024) {
		cam_send(data, 1024); 
		data += 1024;
		length -= 1024;
	}
	if (length > 0) {
		cam_send(data, length); 
	}
}

void cam_send_picture_data_ble(uint8_t *data, int length)
{
	counted_bytes_sent += length;
	app_bt_send_picture_data(data, length);
}

static void client_request_single_capture(struct client_state *state)
{
	if (!state->stream_active) {
		state->req_stream = 1;
		state->req_stream_stop = 1;
	}
}

static void client_request_stream_start_stop(struct client_state *state, bool start)
{
	if (start) {
		state->req_stream = 1;
	} else {
		state->req_stream_stop = 1;
	}
}

static int client_check_start_request(struct client_state *state)
{
	if (state->req_stream && !state->stream_active) {
		state->req_stream = 0;
		state->stream_active = 1;
		return 1;
	}
	return 0;
}

static int client_check_stop_request(struct client_state *state)
{
	if (state->req_stream_stop && state->stream_active) {
		state->req_stream_stop = 0;
		state->stream_active = 0;
		return 1;
	}
	return 0;
}

void video_preview(void)
{
	int err;
	static bool capture_flag = false;
	enum video_frame_fragmented_status f_status;

	err = video_dequeue(video, VIDEO_EP_OUT, &vbuf, K_FOREVER);
	if (err)
	{
		LOG_INF("Unable to dequeue video buf");
		return;
	}
	f_status = vbuf->flags;
	
	LOG_DBG("CF1: f_status %i, bytesframe %i, bytesused %i. cf %i", f_status, vbuf->bytesframe, vbuf->bytesused, capture_flag);
	
	if (capture_flag)
	{
		capture_flag = false;

		client_check_start_request(&client_state_ble);
		client_check_start_request(&client_state_socket);

		if (client_state_ble.stream_active) {
			app_bt_send_picture_header(vbuf->bytesframe);
		} 
		if (client_state_socket.stream_active) {
			socket_head_and_tail[2] = 0x01;
			cam_send(&socket_head_and_tail[0], 3);
			cam_send((uint8_t *)&vbuf->bytesframe, 4);
			LOG_DBG("bytesframe:%d",vbuf->bytesframe);
		}
	}

	if (client_state_ble.stream_active) {
		cam_send_picture_data_ble(vbuf->buffer, vbuf->bytesused);
	} 
	if (client_state_socket.stream_active) {
		cam_send_picture_data_socket(vbuf->buffer, vbuf->bytesused);
		LOG_DBG("bytesused:%d",vbuf->bytesused);
	}

	if (f_status == VIDEO_BUF_EOF)
	{
		capture_flag = true;

		if (client_state_socket.stream_active) {
			cam_send(&socket_head_and_tail[3], 2);
		}

		client_check_stop_request(&client_state_ble);
		client_check_stop_request(&client_state_socket);	
	}

	err = video_enqueue(video, VIDEO_EP_OUT, vbuf);
	if (err)
	{
		LOG_ERR("Unable to requeue video buf");
		return;
	}
}

int report_mega_info(void)
{
	static char str_buf[400];
	uint32_t str_len;
	char *mega_type;

	switch (mega_info.camera_id)
	{
	case ARDUCAM_SENSOR_3MP_1:
	case ARDUCAM_SENSOR_3MP_2:
		mega_type = "3MP";
		break;
	case ARDUCAM_SENSOR_5MP_1:
		mega_type = "5MP";
		break;
	case ARDUCAM_SENSOR_5MP_2:
		mega_type = "5MP_2";
		break;
	default:
		return -ENODEV;
	}

	sprintf(str_buf,
			"ReportCameraInfo\r\nCamera Type:%s\r\n"
			"Camera Support Resolution:%d\r\nCamera Support "
			"special effects:%d\r\nCamera Support Focus:%d\r\n"
			"Camera Exposure Value Max:%ld\r\nCamera Exposure Value "
			"Min:%d\r\nCamera Gain Value Max:%d\r\nCamera Gain Value "
			"Min:%d\r\nCamera Support Sharpness:%d\r\n",
			mega_type, mega_info.support_resolution, mega_info.support_special_effects,
			mega_info.enable_focus, mega_info.exposure_value_max, mega_info.exposure_value_min,
			mega_info.gain_value_max, mega_info.gain_value_min, mega_info.enable_sharpness);
	printk("%s", str_buf);
	str_len = strlen(str_buf);
	cam_to_pc_command_send(0x02, str_buf, str_len);
	return 0;
}

uint8_t recv_process(uint8_t *buff)
{
	LOG_INF("recv_process: cmd %x, data %x", buff[0], buff[1]);
	switch (buff[0])
	{
	case SET_PICTURE_RESOLUTION:
		LOG_INF("camcmd: SET_PICTURE_RESOLUTION");
		if (set_mega_resolution(buff[1], client_type_SOCKET) == 0)
		{
			take_picture_fmt = buff[1];
		}
		break;
	case SET_VIDEO_RESOLUTION:
		LOG_INF("camcmd: SET_VIDEO_RESOLUTION");
		if (!client_state_socket.stream_active)
		{
			set_mega_resolution(buff[1] | 0x10, client_type_SOCKET);
			client_request_stream_start_stop(&client_state_socket, true);
		}
		break;
	case SET_BRIGHTNESS:
		video_set_ctrl(video, VIDEO_CID_CAMERA_BRIGHTNESS, &buff[1]);
		break;
	case SET_CONTRAST:
		video_set_ctrl(video, VIDEO_CID_CAMERA_CONTRAST, &buff[1]);
		break;
	case SET_SATURATION:
		video_set_ctrl(video, VIDEO_CID_CAMERA_SATURATION, &buff[1]);
		break;
	case SET_EV:
		video_set_ctrl(video, VIDEO_CID_ARDUCAM_EV, &buff[1]);
		break;
	case SET_WHITEBALANCE:
		video_set_ctrl(video, VIDEO_CID_CAMERA_WHITE_BAL, &buff[1]);
		break;
	case SET_SPECIAL_EFFECTS:
		video_set_ctrl(video, VIDEO_CID_ARDUCAM_COLOR_FX, &buff[1]);
		break;
	case SET_EXPOSURE_GAIN_ENABLE:
		video_set_ctrl(video, VIDEO_CID_CAMERA_EXPOSURE_AUTO, &buff[1]);
		video_set_ctrl(video, VIDEO_CID_CAMERA_GAIN_AUTO, &buff[1]);
	case SET_WHITE_BALANCE_ENABLE:
		video_set_ctrl(video, VIDEO_CID_CAMERA_WHITE_BAL_AUTO, &buff[1]);
		break;
	case SET_SHARPNESS:
		video_set_ctrl(video, VIDEO_CID_ARDUCAM_SHARPNESS, &buff[1]);
		break;
	case SET_MANUAL_GAIN:
		uint16_t gain_value = (buff[1] << 8) | buff[2];

		video_set_ctrl(video, VIDEO_CID_CAMERA_GAIN, &gain_value);
		break;
	case SET_MANUAL_EXPOSURE:
		uint32_t exposure_value = (buff[1] << 16) | (buff[2] << 8) | buff[3];

		video_set_ctrl(video, VIDEO_CID_CAMERA_EXPOSURE, &exposure_value);
		break;
	case GET_CAMERA_INFO:
		report_mega_info();
		break;
	case TAKE_PICTURE:
		LOG_INF("Take picture");
		client_request_single_capture(&client_state_socket);
		break;
	case STOP_STREAM:
		if (client_state_socket.stream_active)
		{
			LOG_INF("Stop video stream");
			client_request_stream_start_stop(&client_state_socket, false);
		}
		break;
	case RESET_CAMERA:
		video_set_ctrl(video, VIDEO_CID_ARDUCAM_RESET, NULL);
		break;
	case SET_IMAGE_QUALITY:
		video_set_ctrl(video, VIDEO_CID_JPEG_COMPRESSION_QUALITY, &buff[1]);
		break;
	case SET_LOWPOWER_MODE:
		video_set_ctrl(video, VIDEO_CID_ARDUCAM_LOWPOWER, &buff[1]);
		break;
	default:
		break;
	}

	return buff[0];
}

static void register_app_command(const struct app_command_t *command)
{
	if (k_msgq_put(&msgq_app_commands, command, K_NO_WAIT) != 0) {
		LOG_ERR("Command buffer full!");
	}
}

void app_bt_connected_callback(void)
{	
	LOG_INF("Bluetooth connection established");
	//cam_send command 0x08 to inform WiFi Host BLE client is connected.
	cam_to_pc_command_send(0x08, NULL,0);
}

void app_bt_ready_callback(void)
{
	LOG_INF("Bluetooth client ready");
	app_bt_send_client_status(((mega_info.camera_id == ARDUCAM_SENSOR_3MP_1 || mega_info.camera_id == ARDUCAM_SENSOR_3MP_2)) ? 1 : 2, current_resolution);
	
}

void app_bt_disconnected_callback(void)
{
	LOG_INF("Bluetooth disconnected");
	
	client_state_ble.req_stream = 0;
	client_state_ble.req_stream_stop = 0;
	client_state_ble.stream_active = 0;
	//cam_send command 0x09 to inform WiFi Host BLE client is disconnected.
	cam_to_pc_command_send(0x09, NULL,0);
}

void app_bt_take_picture_callback(void)
{
	static struct app_command_t cmd_take_picture = 
		{.type = APPCMD_TAKE_PICTURE, .mode = client_type_BLE,};
	register_app_command(&cmd_take_picture);
}

void app_bt_enable_stream_callback(bool enable)
{
	static struct app_command_t cmd_stream_start_stop = 
		{.type = APPCMD_START_STOP_STREAM, .mode = client_type_BLE,};
	cmd_stream_start_stop.data[0] = enable ? 1 : 0;
	register_app_command(&cmd_stream_start_stop);
}

void app_bt_change_resolution_callback(uint8_t resolution)
{
	static struct app_command_t cmd_take_picture = 
		{.type = APPCMD_CAM_COMMAND, 
		 .cam_cmd = SET_PICTURE_RESOLUTION};
	cmd_take_picture.data[0] = 0x10 | (resolution & 0xF);
	register_app_command(&cmd_take_picture);
}

const struct app_bt_cb app_bt_callbacks = {
	.connected = app_bt_connected_callback,
	.ready = app_bt_ready_callback,
	.disconnected = app_bt_disconnected_callback,
    .take_picture = app_bt_take_picture_callback,
	.enable_stream = app_bt_enable_stream_callback,
	.change_resolution = app_bt_change_resolution_callback,
};

static void on_timer_count_bytes_func(struct k_timer *timer)
{
	if (counted_bytes_sent > 0) {
		LOG_INF("Data transferred: %i kbps", (counted_bytes_sent * 8) / 1024);
		counted_bytes_sent = 0;
	}
}

void socket_rx_callback(uint8_t *data, uint16_t len)
{
	static struct app_command_t app_cmd_socket = {.type = APPCMD_SOCKET_RX};
	LOG_DBG("SOCKET RX callback");
	memcpy(app_cmd_socket.data, data, len);
	register_app_command(&app_cmd_socket);
}

int main(void)
{
	int ret;
	struct video_buffer *buffers[3];
#if defined(CLOCK_FEATURE_HFCLK_DIVIDE_PRESENT) || NRF_CLOCK_HAS_HFCLK192M

	/* hardcode to 128MHz */
	nrfx_clock_divider_set(NRF_CLOCK_DOMAIN_HFCLK, NRF_CLOCK_HFCLK_DIV_1);
#endif
	k_sleep(K_SECONDS(1));
	printk("Starting %s with CPU frequency: %d MHz\n", CONFIG_BOARD, SystemCoreClock / MHZ(1));

	video = DEVICE_DT_GET(DT_NODELABEL(arducam_mega0));

	if (!device_is_ready(video))
	{
		LOG_ERR("Video device %s not ready.", video->name);
		return -1;
	}

	video_stream_stop(video);
	LOG_INF("Device %s is ready!", video->name);

	video_get_ctrl(video, VIDEO_CID_ARDUCAM_INFO, &mega_info);

	ret = app_bt_init(&app_bt_callbacks);
	if (ret < 0) {
		LOG_ERR("Error initializing Bluetooth");
		return -1;
	}

	net_util_set_callback(socket_rx_callback);

	/* Alloc video buffers and enqueue for capture */
	for (int i = 0; i < ARRAY_SIZE(buffers); i++)
	{
		buffers[i] = video_buffer_alloc(4096);
		if (buffers[i] == NULL)
		{
			LOG_ERR("Unable to alloc video buffer");
			return -1;
		}
		video_enqueue(video, VIDEO_EP_OUT, buffers[i]);
	}

	k_timer_start(&m_timer_count_bytes, K_MSEC(1000), K_MSEC(1000));
	
	set_mega_resolution(0x11, client_type_NONE);

	video_stream_start(video);
	
	while (1) {
		struct app_command_t new_command;
		if (k_msgq_get(&msgq_app_commands, &new_command, K_USEC(50)) == 0) {
			switch (new_command.type) {
				case APPCMD_TAKE_PICTURE:
					LOG_INF("TAKE PICTURE");
					client_request_single_capture(&client_state_ble);
					break;
				case APPCMD_CAM_COMMAND:
					switch (new_command.cam_cmd) {
						case SET_PICTURE_RESOLUTION:
							LOG_INF("Change resolution to 0x%x", new_command.data[0]);
							set_mega_resolution(new_command.data[0], client_type_BLE);
							break;
					}
					break;
				case APPCMD_START_STOP_STREAM:
					bool enable = new_command.data[0] > 0; 
					
					if (enable) {
						LOG_INF("Starting stream!");
						client_request_stream_start_stop(&client_state_ble, true);
					} else {
						LOG_INF("Stopping stream");
						client_request_stream_start_stop(&client_state_ble, false);
					}
					break;
				case APPCMD_SOCKET_RX:
					uint8_t socket_cmd_buf[CAM_COMMAND_MAX_SIZE - 2];
					ret = process_socket_rx_buffer(new_command.data, socket_cmd_buf);
					if (ret > 0)
					{
						LOG_INF("Valid command received. Length:%d", ret);
						LOG_HEXDUMP_INF(socket_cmd_buf, ret, "Data: ");
						recv_process(socket_cmd_buf);
					}
					else
					{
						LOG_INF("Invalid SOCKET command received:%d", ret);
					}
					break;
			}
		}

		video_preview();
	}
	return 0;
}
```

## include/app_bluetooth.h
```c
#ifndef __APP_BLUETOOTH_H
#define __APP_BLUETOOTH_H

#include <zephyr/types.h>
#include <zephyr/kernel.h>

// Callbacks from the app_bluetooth module to the application
typedef void (*app_bt_connected_cb)(void);
typedef void (*app_bt_ready_cb)(void);
typedef void (*app_bt_disconnected_cb)(void);
typedef void (*app_bt_take_picture_cb)(void);
typedef void (*app_bt_enable_stream_cb)(bool enable);
typedef void (*app_bt_change_resolution_cb)(uint8_t resolution);

struct app_bt_cb {
    app_bt_connected_cb connected;
    app_bt_ready_cb ready;
    app_bt_disconnected_cb disconnected;
    app_bt_take_picture_cb take_picture;
    app_bt_enable_stream_cb enable_stream;
    app_bt_change_resolution_cb change_resolution;
};

int app_bt_init(const struct app_bt_cb *callbacks);

int app_bt_send_picture_header(uint32_t pic_size);

int app_bt_send_picture_data(uint8_t *buf, uint16_t len);

int app_bt_send_client_status(uint8_t cam_model, uint8_t resolution);

#endif
```

## include/its.h
```c
/*
 * Copyright (c) 2018 Nordic Semiconductor ASA
 *
 * SPDX-License-Identifier: LicenseRef-Nordic-5-Clause
 */

#ifndef __BT_ITS_H
#define __BT_ITS_H

#ifdef __cplusplus
extern "C" {
#endif

#include <zephyr/types.h>

#define BT_UUID_ITS_VAL \
	BT_UUID_128_ENCODE(0x6E400001, 0xB5A3, 0xF393, 0xE0A9, 0xE50E24DCCA3E)

#define BT_UUID_ITS_TX_VAL \
	BT_UUID_128_ENCODE(0x6E400003, 0xB5A3, 0xF393, 0xE0A9, 0xE50E24DCCA3E)

#define BT_UUID_ITS_RX_VAL \
	BT_UUID_128_ENCODE(0x6E400002, 0xB5A3, 0xF393, 0xE0A9, 0xE50E24DCCA3E)

#define BT_UUID_ITS_IMG_INFO_VAL \
	BT_UUID_128_ENCODE(0x6E400004, 0xB5A3, 0xF393, 0xE0A9, 0xE50E24DCCA3E)

#define BT_UUID_ITS           BT_UUID_DECLARE_128(BT_UUID_ITS_VAL)
#define BT_UUID_ITS_TX    	  BT_UUID_DECLARE_128(BT_UUID_ITS_TX_VAL)
#define BT_UUID_ITS_RX        BT_UUID_DECLARE_128(BT_UUID_ITS_RX_VAL)
#define BT_UUID_ITS_IMG_INFO  BT_UUID_DECLARE_128(BT_UUID_ITS_IMG_INFO_VAL)

enum its_rx_cmd_e {ITS_RX_CMD_SINGLE_CAPTURE = 1, 
				   ITS_RX_CMD_START_STREAM, 
				   ITS_RX_CMD_STOP_STREAM,
				   ITS_RX_CMD_CHANGE_RESOLUTION, 
				   ITS_RX_CMD_CHANGE_PHY,
				   ITS_RX_CMD_SEND_BLE_PARAMS};

struct its_rx_cb_evt_t {
	enum its_rx_cmd_e command;
	uint8_t *data;
	uint32_t len;
};

/** @brief Callback type for when the ITS service is ready */
typedef void (*its_ready_cb_t)(void);

/** @brief Callback type for when RX data is received. */
typedef void (*its_rx_cb_t)(struct its_rx_cb_evt_t *evt);

/** @brief Callback struct used by the ITS Service. */
struct bt_its_cb {
	/** ITS Ready callback */
	its_ready_cb_t ready_cb;
	
	/** ITS RX callback. */
	its_rx_cb_t rx_cb;
};

enum its_img_info_data_type_e {ITS_IMG_INFO_DATA_TYPE_IMG_INFO = 1, ITS_IMG_INFO_DATA_TYPE_BLE_PARAMS = 2, ITS_IMG_INFO_DATA_TYPE_CLIENT_STATUS = 3};

struct its_img_info_t {
    uint32_t file_size_bytes;   
};

struct its_ble_params_info_t {
    uint16_t mtu;
    uint16_t con_interval;
    uint8_t  tx_phy;
    uint8_t  rx_phy;
};

enum its_camera_type_e {ITS_CAM_TYPE_3MP = 1, ITS_CAM_TYPE_5MP = 2};

struct its_client_status_t {
	uint8_t camera_type;
	uint8_t selected_resolution_index;
};

int bt_its_init(struct bt_its_cb *callbacks);

int bt_its_send_img_data(struct bt_conn *conn, uint8_t *buf, uint16_t length, uint16_t le_max_length);

int bt_its_send_img_info(struct its_img_info_t *img_info);

int bt_its_send_ble_params_info(struct its_ble_params_info_t *ble_params_info);

int bt_its_send_client_status(struct its_client_status_t *client_status);

#ifdef __cplusplus
}
#endif

#endif /* BT_ITS_H_ */
```

## include/net_util.h
```c
#ifndef __NET_UTIL_H
#define __NET_UTIL_H

#include <zephyr/kernel.h>

#define UDP_COMMAND_MAX_SIZE 6

/* actucal command not count start(0x55) and stop(0xAA) codes*/
extern uint8_t udp_head_and_tail[];

typedef void (*net_util_udp_rx_callback_t)(uint8_t *data, uint16_t len);

void net_util_set_callback(net_util_udp_rx_callback_t udp_rx_callback);

uint8_t process_udp_rx_buffer(char *udp_rx_buf, char *command_buf);

#endif
```

## include/socket_util.h
```c
#ifndef __SOCKET_UTIL_H
#define __SOCKET_UTIL_H

#include <zephyr/kernel.h>

#define CAM_COMMAND_MAX_SIZE 6

enum wifi_modes {
	WIFI_STATION_MODE = 0,
    WIFI_SOFTAP_MODE,
};

typedef void (*net_util_socket_rx_callback_t)(uint8_t *data, uint16_t len);

void net_util_set_callback(net_util_socket_rx_callback_t socket_rx_callback);
void cam_send(const void *buf, size_t len);

uint8_t process_socket_rx_buffer(char *udp_rx_buf, char *command_buf);

#endif
```

## src/app_bluetooth.c
```c
#include "app_bluetooth.h"

#include <zephyr/bluetooth/bluetooth.h>
#include <zephyr/bluetooth/uuid.h>
#include <zephyr/bluetooth/gatt.h>
#include <zephyr/bluetooth/hci.h>
#include <zephyr/settings/settings.h>
#include "its.h"

#include <zephyr/logging/log.h>

#define LOG_MODULE_NAME app_bluetooth
LOG_MODULE_REGISTER(LOG_MODULE_NAME, LOG_LEVEL_INF);

#define DEVICE_NAME CONFIG_BT_DEVICE_NAME
#define DEVICE_NAME_LEN	(sizeof(DEVICE_NAME) - 1)

static const struct bt_le_conn_param *conn_param = BT_LE_CONN_PARAM(9, 9, 0, 400);

static struct bt_conn *current_conn;

static app_bt_connected_cb app_callback_connected;
static app_bt_ready_cb app_callback_ready;
static app_bt_disconnected_cb app_callback_disconnected;
static app_bt_take_picture_cb app_callback_take_picture;
static app_bt_enable_stream_cb app_callback_enable_stream;
static app_bt_change_resolution_cb app_callback_change_resolution;
static struct its_ble_params_info_t ble_params_info = {.con_interval = 0, .mtu = 23, .tx_phy = 1, .rx_phy = 1};

// In order to maximize data throughput, scale the notifications after the TX data length
static int le_tx_data_length = 20;

enum app_bt_internal_commands {APP_BT_INT_ITS_RX_EVT, APP_BT_INT_SCHEDULE_CONNECTED_CB, APP_BT_INT_SCHEDULE_READY_CB, APP_BT_INT_SCHEDULE_DISCONNECTED_CB, APP_BT_INT_SCHEDULE_BLE_PARAMS_INFO_UPDATE};
static struct its_rx_cb_evt_t internal_command_evt;

void schedule_ble_params_info_update(void);

struct app_bt_command {
	enum app_bt_internal_commands command;
	struct its_rx_cb_evt_t its_rx_event;
};
K_MSGQ_DEFINE(msgq_its_rx_commands, sizeof(struct app_bt_command), 8, 4);

static const struct bt_data ad[] = {
	BT_DATA_BYTES(BT_DATA_FLAGS, (BT_LE_AD_GENERAL | BT_LE_AD_NO_BREDR)),
	BT_DATA(BT_DATA_NAME_COMPLETE, DEVICE_NAME, DEVICE_NAME_LEN),
};

static const struct bt_data sd[] = {
	BT_DATA_BYTES(BT_DATA_UUID128_ALL, BT_UUID_ITS_VAL),
};

static int schedule_internal_command(enum app_bt_internal_commands command)
{
	internal_command_evt.command = command;
	if (k_msgq_put(&msgq_its_rx_commands, &internal_command_evt, K_NO_WAIT) != 0){
		LOG_ERR("RX cmd message queue full!");
		return -ENOMEM;
	}
	return 0;
}

void att_mtu_updated(struct bt_conn *conn, uint16_t tx, uint16_t rx)
{
	LOG_INF("MTU Updated: tx %d, rx %d", tx, rx);
}

static struct bt_gatt_cb gatt_cb = {
	.att_mtu_updated = att_mtu_updated,
};

static void mtu_exchange_cb(struct bt_conn *conn, uint8_t err, struct bt_gatt_exchange_params *params)
{
	if (!err) {
		int att_mtu = bt_gatt_get_mtu(conn);
		LOG_INF("MTU exchange successful. %i bytes", att_mtu - 3); 
	} else {
		LOG_WRN("MTU exchange failed (err %" PRIu8 ")", err);
	}
}

static void connected(struct bt_conn *conn, uint8_t err)
{
	char addr[BT_ADDR_LE_STR_LEN];

	if (err) {
		LOG_ERR("Connection failed (err %u)", err);
		return;
	}

	bt_addr_le_to_str(bt_conn_get_dst(conn), addr, sizeof(addr));
	LOG_INF("Connected %s", addr);

	current_conn = bt_conn_ref(conn);

	static struct bt_gatt_exchange_params exchange_params;
	exchange_params.func = mtu_exchange_cb;

	err = bt_gatt_exchange_mtu(conn, &exchange_params);
	if (err) {
		printk("MTU exchange failed (err %d)\n", err);
	} else {
		printk("MTU exchange pending\n");
	}

	err = bt_conn_le_data_len_update(conn, BT_LE_DATA_LEN_PARAM_MAX);
	if (err) {
		LOG_ERR("LE data length update request failed: %d",  err);
	}

	err = bt_conn_le_param_update(conn, conn_param);
	if (err) {
		LOG_ERR("Cannot update connection parameter (err: %d)", err);
	}

	schedule_internal_command(APP_BT_INT_SCHEDULE_CONNECTED_CB);
}

static void disconnected(struct bt_conn *conn, uint8_t reason)
{
	char addr[BT_ADDR_LE_STR_LEN];

	bt_addr_le_to_str(bt_conn_get_dst(conn), addr, sizeof(addr));

	LOG_INF("Disconnected: %s (reason %u)", addr, reason);

	if (current_conn) {
		bt_conn_unref(current_conn);
		current_conn = NULL;
	}

	schedule_internal_command(APP_BT_INT_SCHEDULE_DISCONNECTED_CB);
}

static void connection_param_update(struct bt_conn *conn, uint16_t interval, uint16_t latency, uint16_t timeout)
{
	LOG_INF("Con params updated. Connection interval %d ms, latency %i, timeout %i ms", (int) ((float)interval*1.25f), latency, timeout * 10);
	ble_params_info.con_interval = interval;
	schedule_ble_params_info_update();
}

static void le_data_length_updated(struct bt_conn *conn,
				   struct bt_conn_le_data_len_info *info)
{
	LOG_INF("LE data length updated: TX (len: %d time: %d) RX (len: %d time: %d)", 
			info->tx_max_len, info->tx_max_time, info->rx_max_len, info->rx_max_time);

	ble_params_info.mtu = info->tx_max_len;
	schedule_ble_params_info_update();

	// Set the TX data length, which will determine the size of image data transfers. 
	// Subtract 3 bytes for ATT header and 4 bytes for L2CAP header. 
	le_tx_data_length = info->tx_max_len - 7;
	LOG_INF("Notification data length set to %i bytes", le_tx_data_length);
}

static void le_phy_updated(struct bt_conn *conn,
			   struct bt_conn_le_phy_info *param)
{
	LOG_INF("LE PHY updated: TX PHY %i, RX PHY %i\n", param->tx_phy, param->rx_phy);
	ble_params_info.tx_phy = param->tx_phy;
	ble_params_info.rx_phy = param->rx_phy;
	schedule_ble_params_info_update();
}

BT_CONN_CB_DEFINE(conn_callbacks) = {
	.connected    = connected,
	.disconnected = disconnected,
	.le_param_updated = connection_param_update,
	.le_data_len_updated = le_data_length_updated,
	.le_phy_updated = le_phy_updated,
};

void schedule_ble_params_info_update(void)
{
	internal_command_evt.command = APP_BT_INT_SCHEDULE_BLE_PARAMS_INFO_UPDATE;
	if (k_msgq_put(&msgq_its_rx_commands, &internal_command_evt, K_NO_WAIT) != 0){
		LOG_ERR("RX cmd message queue full!");
	}
}

void its_ready_callback(void)
{
	static struct app_bt_command bt_cmd = {.command = APP_BT_INT_SCHEDULE_READY_CB};
	if (k_msgq_put(&msgq_its_rx_commands, &bt_cmd, K_NO_WAIT) != 0) {
		LOG_ERR("APP BT RX CMD queue full");
	}
}

void its_rx_callback(struct its_rx_cb_evt_t *evt)
{
	static struct app_bt_command bt_cmd = {.command = APP_BT_INT_ITS_RX_EVT};
	bt_cmd.its_rx_event = *evt;
	if (k_msgq_put(&msgq_its_rx_commands, &bt_cmd, K_NO_WAIT) != 0) {
		LOG_ERR("APP BT RX CMD queue full");
	}
}

static struct bt_its_cb its_cb = {
	.ready_cb = its_ready_callback,
	.rx_cb = its_rx_callback,
};

static void app_bt_thread_func(void)
{
	int err;
	struct app_bt_command app_cmd;
	while (1) {
		k_msgq_get(&msgq_its_rx_commands, &app_cmd, K_FOREVER);

		if(app_cmd.command == APP_BT_INT_ITS_RX_EVT) {
			// Commands originating from the Image Transfer Service
			switch (app_cmd.its_rx_event.command) {
				case ITS_RX_CMD_SINGLE_CAPTURE:
					LOG_DBG("ITS RX CMD: SingleCapture");
					if (app_callback_take_picture) {
						app_callback_take_picture();
					}
					break;
				case ITS_RX_CMD_START_STREAM:
					LOG_DBG("ITS RX CMD: Start Stream");
					if (app_callback_enable_stream) {
						app_callback_enable_stream(true);
					}
					break;
				case ITS_RX_CMD_STOP_STREAM:
					LOG_DBG("ITS RX CMD: Stop stream");
					if (app_callback_enable_stream) {
						app_callback_enable_stream(false);
					}
					break;
				case ITS_RX_CMD_CHANGE_RESOLUTION:
					LOG_DBG("ITS RX CMD: Change res");
					if (app_callback_change_resolution) {
						app_callback_change_resolution(app_cmd.its_rx_event.data[0]);
					}
					break;
				case ITS_RX_CMD_CHANGE_PHY:
					LOG_DBG("ITS RX CMD: Change phy (%i)", app_cmd.its_rx_event.data[0]);
					err = bt_conn_le_phy_update(current_conn, (app_cmd.its_rx_event.data[0] == 1) ? BT_CONN_LE_PHY_PARAM_2M : BT_CONN_LE_PHY_PARAM_1M);
					if (err) {
						LOG_ERR("Phy update request failed: %d",  err);
					}
					break;
				case ITS_RX_CMD_SEND_BLE_PARAMS:
					LOG_DBG("ITS RX CMD: Send ble params");
					break;
			
				default:
					LOG_ERR("CMD:Invalid command!");
					break;
			}
		} else {
			switch (app_cmd.command) {
				case APP_BT_INT_SCHEDULE_CONNECTED_CB:
					if (app_callback_connected) {
						app_callback_connected();
					}
					break;
				case APP_BT_INT_SCHEDULE_READY_CB:
					if (app_callback_ready) {
						app_callback_ready();
					}
					break;
				case APP_BT_INT_SCHEDULE_DISCONNECTED_CB:
					if (app_callback_disconnected) {
						app_callback_disconnected();
					}
					break;
				case APP_BT_INT_SCHEDULE_BLE_PARAMS_INFO_UPDATE:
					err = bt_its_send_ble_params_info(&ble_params_info);	
					if (err) {
						LOG_ERR("Error sending ble params");
					}
					break;
				default:
					break;
			}
		}
	}
}

int app_bt_init(const struct app_bt_cb *callbacks)
{
	int err = 0;

	if (callbacks) {
		app_callback_connected = callbacks->connected;
		app_callback_ready = callbacks->ready;
		app_callback_disconnected = callbacks->disconnected;
		app_callback_take_picture = callbacks->take_picture;
		app_callback_enable_stream = callbacks->enable_stream;
		app_callback_change_resolution = callbacks->change_resolution;
	}

	err = bt_enable(NULL);
	if (err) {
		return err;
	}

	LOG_DBG("Bluetooth initialized");

	bt_gatt_cb_register(&gatt_cb);

	if (IS_ENABLED(CONFIG_SETTINGS)) {
		settings_load();
	}

    err = bt_its_init(&its_cb);
	if (err) {
		LOG_ERR("Failed to initialize Image Transfer Service (err: %d)", err);
		return 0;
	}

	err = bt_le_adv_start(BT_LE_ADV_CONN, ad, ARRAY_SIZE(ad), sd, ARRAY_SIZE(sd));
	if (err) {
		LOG_ERR("Advertising failed to start (err %d)", err);
		return err;
	}

    return 0;
}

int app_bt_send_picture_header(uint32_t pic_size)
{
	struct its_img_info_t img_info = {.file_size_bytes = pic_size};
	return bt_its_send_img_info(&img_info);
}

int app_bt_send_picture_data(uint8_t *buf, uint16_t len)
{
	return bt_its_send_img_data(current_conn, buf, len, le_tx_data_length);
}

int app_bt_send_client_status(uint8_t cam_model, uint8_t resolution)
{
	struct its_client_status_t client_status = {.camera_type = cam_model, .selected_resolution_index = resolution};
	return bt_its_send_client_status(&client_status);
}

K_THREAD_DEFINE(app_bt_thread, 2048, app_bt_thread_func, NULL, NULL, NULL, 
				K_PRIO_PREEMPT(K_LOWEST_APPLICATION_THREAD_PRIO), 0, 0);
```

## src/its.c
```c
/*
 * Copyright (c) 2018 Nordic Semiconductor ASA
 *
 * SPDX-License-Identifier: LicenseRef-Nordic-5-Clause
 */

/** @file
 *  @brief LED Button Service (ITS) sample
 */

#include <zephyr/types.h>
#include <stddef.h>
#include <string.h>
#include <errno.h>
#include <zephyr/sys/printk.h>
#include <zephyr/sys/byteorder.h>
#include <zephyr/kernel.h>

#include <zephyr/bluetooth/bluetooth.h>
#include <zephyr/bluetooth/hci.h>
#include <zephyr/bluetooth/conn.h>
#include <zephyr/bluetooth/uuid.h>
#include <zephyr/bluetooth/gatt.h>

#include "its.h"

#include <zephyr/logging/log.h>

LOG_MODULE_REGISTER(bt_its, LOG_LEVEL_INF);

static bool                   notify_enabled[2];
static struct bt_its_cb       its_cb;
static struct its_rx_cb_evt_t cb_evt;
static struct its_ble_params_info_t scheduled_params = {.con_interval = 0};

static void its_tx_ccc_changed(const struct bt_gatt_attr *attr,
				  uint16_t value)
{
	LOG_DBG("Notify updated on TX char, handle %i, value %i", attr->handle, value);
	notify_enabled[0] = (value == BT_GATT_CCC_NOTIFY);
}

static void its_img_info_ccc_changed(const struct bt_gatt_attr *attr,
				  uint16_t value)
{
	LOG_DBG("Notify updated on img info char, handle %i, value %i", attr->handle, value);
	notify_enabled[1] = (value == BT_GATT_CCC_NOTIFY);
	if (scheduled_params.con_interval != 0) {
		bt_its_send_ble_params_info(&scheduled_params);
		scheduled_params.con_interval = 0;
	}
	if (its_cb.ready_cb) {
		its_cb.ready_cb();
	}
}

static ssize_t its_rx_received(struct bt_conn *conn,
			 const struct bt_gatt_attr *attr,
			 const void *buf,
			 uint16_t len, uint16_t offset, uint8_t flags)
{
	LOG_DBG("Attribute write, handle: %u, conn: %p", attr->handle,
		(void *)conn);

	if (offset != 0) {
		LOG_DBG("Write RX char: Incorrect data offset");
		return BT_GATT_ERR(BT_ATT_ERR_INVALID_OFFSET);
	}

	uint8_t *byte_ptr = (uint8_t*)buf;

	if (its_cb.rx_cb) {
		cb_evt.command = byte_ptr[0];
		cb_evt.data = &byte_ptr[1];
		cb_evt.len = len - 1;
		its_cb.rx_cb(&cb_evt);
	}

	return len;
}

#ifdef CONFIG_BT_ITS_POLL_BUTTON
static ssize_t read_button(struct bt_conn *conn,
			  const struct bt_gatt_attr *attr,
			  void *buf,
			  uint16_t len,
			  uint16_t offset)
{
	const char *value = attr->user_data;

	LOG_DBG("Attribute read, handle: %u, conn: %p", attr->handle,
		(void *)conn);

	if (its_cb.button_cb) {
		button_state = its_cb.button_cb();
		return bt_gatt_attr_read(conn, attr, buf, len, offset, value,
					 sizeof(*value));
	}

	return 0;
}
#endif

/* LED Button Service Declaration */
BT_GATT_SERVICE_DEFINE(its_svc,
BT_GATT_PRIMARY_SERVICE(BT_UUID_ITS), 					    // Attr index: 0
	BT_GATT_CHARACTERISTIC(BT_UUID_ITS_TX,					// Attr index: 1,2
			       BT_GATT_CHRC_READ | BT_GATT_CHRC_NOTIFY,
			       BT_GATT_PERM_READ, NULL, NULL, NULL),
	BT_GATT_CCC(its_tx_ccc_changed,							// Attr index: 3
		    BT_GATT_PERM_READ | BT_GATT_PERM_WRITE),
	BT_GATT_CHARACTERISTIC(BT_UUID_ITS_RX,					// Attr index: 4,5
			       BT_GATT_CHRC_WRITE,
			       BT_GATT_PERM_WRITE,
			       NULL, its_rx_received, NULL),
	BT_GATT_CHARACTERISTIC(BT_UUID_ITS_IMG_INFO,			// Attr index: 6,7
			       BT_GATT_CHRC_READ | BT_GATT_CHRC_NOTIFY,
			       BT_GATT_PERM_READ, NULL, NULL, NULL),
	BT_GATT_CCC(its_img_info_ccc_changed,				    // Attr index: 8
		    BT_GATT_PERM_READ | BT_GATT_PERM_WRITE),
);

int bt_its_init(struct bt_its_cb *callbacks)
{
	if (callbacks) {
		its_cb.ready_cb = callbacks->ready_cb;
		its_cb.rx_cb = callbacks->rx_cb;
	}

	return 0;
}

int bt_its_send_img_data(struct bt_conn *conn, uint8_t *buf, uint16_t length, uint16_t le_max_length)
{
	int err;
	uint8_t *current_buf = buf;

	LOG_DBG("IMG buf length %i", length);
	while (length > le_max_length) {
		LOG_DBG("Notify TX: Len %i, Remaining: %i", le_max_length, length);
		err = bt_gatt_notify(NULL, &its_svc.attrs[2], current_buf, le_max_length);
		if (err < 0) {
			LOG_ERR("BT notify error: %i", err);
		}
		current_buf += le_max_length;
		length -= le_max_length;
	}

	LOG_DBG("Notify TX remaining %i bytes", length);
	err = bt_gatt_notify(NULL, &its_svc.attrs[2], current_buf, length);
	if (err < 0) {
		LOG_ERR("BT notify error: %i", err);
	}

	return 0;
}

int bt_its_send_img_info(struct its_img_info_t * img_info)
{
	uint8_t notify_buf[1 + sizeof(struct its_img_info_t)];

	if (!notify_enabled[1]) {
		return -EACCES;
	}

	notify_buf[0] = ITS_IMG_INFO_DATA_TYPE_IMG_INFO;
	memcpy(&notify_buf[1], img_info, sizeof(struct its_img_info_t));
	
	LOG_DBG("IMG info Notify TX %i bytes. Img size: %i", 1 + sizeof(struct its_img_info_t), img_info->file_size_bytes);

	return bt_gatt_notify(NULL, &its_svc.attrs[7], 
						  notify_buf, 1 + sizeof(struct its_img_info_t));
}

int bt_its_send_client_status(struct its_client_status_t * client_status)
{
	uint8_t data_size = sizeof(struct its_client_status_t);
	uint8_t notify_buf[data_size + 1];

	if (!notify_enabled[1]) {
		return -EACCES;
	}

	notify_buf[0] = ITS_IMG_INFO_DATA_TYPE_CLIENT_STATUS;
	memcpy(&notify_buf[1], client_status, data_size);
	
	LOG_DBG("Client status Notify TX %i bytes. Cam model %i, resolution: %i", data_size + 1, 
			client_status->camera_type, client_status->selected_resolution_index);

	return bt_gatt_notify(NULL, &its_svc.attrs[7], notify_buf, data_size + 1);
}

int bt_its_send_ble_params_info(struct its_ble_params_info_t* ble_params_info)
{
	uint8_t notify_buf[1 + sizeof(struct its_ble_params_info_t)];

	if (!notify_enabled[1]) {
		// If notifications have not yet been enabled, schedule the params to be sent later
		scheduled_params = *ble_params_info;
		LOG_DBG("Scheduling params info for later");
		
		return 0;
	}

	notify_buf[0] = ITS_IMG_INFO_DATA_TYPE_BLE_PARAMS;
	memcpy(&notify_buf[1], ble_params_info, sizeof(struct its_ble_params_info_t));
	
	LOG_DBG("BLE params Notify TX %i bytes",  1 + sizeof(struct its_ble_params_info_t));
	
	return bt_gatt_notify(NULL, &its_svc.attrs[7], 
						  notify_buf, 1 + sizeof(struct its_ble_params_info_t));
}
```

## src/socket_util.c
```c
/*
 * Copyright (c) 2024 Nordic Semiconductor ASA
 *
 * SPDX-License-Identifier: LicenseRef-Nordic-5-Clause
 */
#include <zephyr/logging/log.h>
LOG_MODULE_REGISTER(socket_util, CONFIG_LOG_DEFAULT_LEVEL);

#include <errno.h>
#include <stddef.h>
#include <string.h>
#include <stdio.h>
#include <zephyr/kernel.h>
#include <zephyr/types.h>
#include <zephyr/net/socket.h>
/* Macro called upon a fatal error, reboots the device. */
#include <zephyr/sys/reboot.h>
#include <dk_buttons_and_leds.h>
#include <zephyr/logging/log_ctrl.h>
#include "socket_util.h"

#define FATAL_ERROR()                              \
	LOG_ERR("Fatal error! Rebooting the device."); \
	LOG_PANIC();                                   \
	IF_ENABLED(CONFIG_REBOOT, (sys_reboot(0)))

/* size of stack area used by each thread */
#define STACKSIZE 8192
/* scheduling priority used by each thread */
#define PRIORITY 3
/* Same as COMMAND_MAX_SIZE*/
#define BUFFER_MAX_SIZE 6

//#define pc_port  60000
#define cam_port 60010 // use for either udp or tcp server


/**********External Resources START**************/
extern int wifi_softap_mode_ready(void);
extern int wifi_station_mode_ready(void);
/**********External Resources END**************/

int udp_socket;
int tcp_server_listen_fd;
int tcp_server_socket;
struct sockaddr_in cam_addr;
bool socket_connected=false;

char pc_addr_str[32];
struct sockaddr_in pc_addr;
socklen_t pc_addr_len=sizeof(pc_addr);

/* Define the semaphore wifi_net_ready */
struct k_sem wifi_net_ready;
enum wifi_modes wifi_mode=WIFI_STATION_MODE;

uint8_t socket_recv_buf[BUFFER_MAX_SIZE];
K_MSGQ_DEFINE(socket_recv_queue, sizeof(socket_recv_buf), 1, 4);

static net_util_socket_rx_callback_t socket_rx_cb = 0; 

void net_util_set_callback(net_util_socket_rx_callback_t socket_rx_callback)
{
	socket_rx_cb = socket_rx_callback;
	// If any messages are waiting in the queue, forward them immediately
	uint8_t buf[6];
	while (k_msgq_get(&socket_recv_queue, buf, K_NO_WAIT) == 0) {
		socket_rx_cb(buf, 6);
		LOG_HEXDUMP_INF(buf, 6, "socket_rx_cb");
	}
}

uint8_t process_socket_rx_buffer(char *socket_rx_buf, char *command_buf)
{
	uint8_t command_length = 0;

	// Check if socket_rx_buf contains start code (0x55)
	if (socket_rx_buf[0] == 0x55)
	{
		// Find the end code (0xAA) and extract the command
		for (uint8_t i = 1; i < CAM_COMMAND_MAX_SIZE; i++)
		{
			if (socket_rx_buf[i] == 0xAA)
			{
				// Copy the command to command_buf
				for (uint8_t j = 1; j < i; j++)
				{
					command_buf[j - 1] = socket_rx_buf[j];
				}
				command_length = i - 1; // Length of the command
				break;
			}
		}
	}
	return command_length;
}

static void trigger_socket_rx_callback_if_set()
{
	if (socket_rx_cb != 0) {
		socket_rx_cb(socket_recv_buf, 6);
	} else {
		k_msgq_put(&socket_recv_queue, &socket_recv_buf, K_NO_WAIT);
	}
}

static void button_handler(uint32_t button_state, uint32_t has_changed)
{
	uint32_t buttons = button_state & has_changed;
	if (buttons & DK_BTN1_MSK) {
		wifi_mode = WIFI_SOFTAP_MODE;
	}else if (buttons & DK_BTN2_MSK){
		close(tcp_server_listen_fd);
		close(tcp_server_socket);
	}
}

void cam_send(const void *buf, size_t len){
		#if defined(CONFIG_SAMPLE_SCOKET_TCP)
			if (send(tcp_server_socket, buf, len, 0) == -1) {
				perror("Sending failed");
				close(tcp_server_socket);
				FATAL_ERROR();
				return;
			}
		#else
			sendto(udp_socket, buf, len, 0, (struct sockaddr *)&pc_addr,  sizeof(pc_addr));
		#endif
}

/* Thread to setup WiFi, Network, Sockets step by step */
static void wifi_net_sockets(void)
{
	int ret;
	ssize_t bytes_recived;

	k_sem_init(&wifi_net_ready, 0, 1);

	if (dk_leds_init() != 0)
	{
		LOG_ERR("Failed to initialize the LED library");
	}
	if (dk_buttons_init(button_handler)!= 0)
	{
		LOG_ERR("Failed to initialize the LED library");
	}
	LOG_INF("\r\n\r\nPress Button1 in THREE seconds to change WiFi from Station mode to softAP mode.\r\n");
	k_sleep(K_SECONDS(3));

    if(wifi_mode == WIFI_SOFTAP_MODE){
		ret = wifi_softap_mode_ready();
	}else{
		ret = wifi_station_mode_ready();
	}

	if (ret < 0)
	{
		LOG_ERR("wifi network connection is not ready, error: %d", -errno);
		FATAL_ERROR();
		return;
	}

	cam_addr.sin_family = AF_INET;
	cam_addr.sin_addr.s_addr = htonl(INADDR_ANY);
	cam_addr.sin_port = htons(cam_port);

	#if defined(CONFIG_SAMPLE_SCOKET_TCP)
		tcp_server_listen_fd = socket(AF_INET, SOCK_STREAM, IPPROTO_TCP);
		
		if (tcp_server_listen_fd < 0)
		{
			LOG_ERR("Failed to create socket: %d", -errno);
			FATAL_ERROR();
			return;
		}
		
		ret = bind(tcp_server_listen_fd, (struct sockaddr *)&cam_addr, sizeof(cam_addr));
		if (ret < 0)
		{
			LOG_ERR("bind, error: %d", -errno);
			FATAL_ERROR();
			return;
		}

		ret = listen(tcp_server_listen_fd, 5);
		if (ret < 0)
		{
			LOG_ERR("listen, error: %d", -errno);
			FATAL_ERROR();
			return;
		}

		while(1){
			tcp_server_socket = accept(tcp_server_listen_fd, (struct sockaddr *)&pc_addr, &pc_addr_len);
			if (tcp_server_socket < 0)
			{
				LOG_ERR("accept, error: %d", -errno);
				FATAL_ERROR();
				return;
			}
			LOG_INF("Accepted connection from client\n");
			inet_ntop(pc_addr.sin_family, &pc_addr.sin_addr, pc_addr_str, sizeof(pc_addr_str));
			LOG_INF("Connect with PC through WiFi, PC IPAddr = %s, Port = %d\n", pc_addr_str, ntohs(pc_addr.sin_port));
			// Handle the client connection
			while((bytes_recived = recv(tcp_server_socket, socket_recv_buf, sizeof(socket_recv_buf),0))>0){
				trigger_socket_rx_callback_if_set(socket_recv_buf);
			}
			if (bytes_recived == -1) {
				LOG_ERR("Receiving failed");
			} else if (bytes_recived == 0) {
				LOG_INF("Client disconnected.\n");
			}
			close(tcp_server_socket);
		}
		// Close the server socket (should be unreachable  as the server runs indefinitely)
		close(tcp_server_listen_fd);
	#else
		udp_socket = socket(AF_INET, SOCK_DGRAM, IPPROTO_UDP);
		if (udp_socket < 0)
		{
			LOG_ERR("Failed to create socket: %d", -errno);
			FATAL_ERROR();
			return;
		}
		ret = bind(udp_socket, (struct sockaddr *)&cam_addr, sizeof(cam_addr));
		if (ret < 0)
		{
			LOG_ERR("bind, error: %d", -errno);
			FATAL_ERROR();
			return;
		}
		while((bytes_recived = recvfrom(udp_socket, socket_recv_buf, sizeof(socket_recv_buf), 0, (struct sockaddr *)&pc_addr, &pc_addr_len))>0){
			if(socket_connected == false){
				inet_ntop(pc_addr.sin_family, &pc_addr.sin_addr, pc_addr_str, sizeof(pc_addr_str));
				LOG_INF("Connect with PC through WiFi, PC IPAddr = %s, Port = %d\n", pc_addr_str, ntohs(pc_addr.sin_port));
				socket_connected=true;
			}
			trigger_socket_rx_callback_if_set(socket_recv_buf);
		}
		if (bytes_recived == -1) {
			LOG_ERR("Receiving failed");
		} else if (bytes_recived == 0) {
			LOG_INF("Client disconnected.\n");
		}

		close(udp_socket);
		socket_connected=false;

	#endif
}

K_THREAD_DEFINE(wifi_net_sockets_id, STACKSIZE, wifi_net_sockets, NULL, NULL, NULL,
				PRIORITY, 0, 0);
```
